## code/zmk/boards/shields/chastity/Kconfig.defconfig
```kconfig
if SHIELD_CHASTITY_LEFT

config ZMK_KEYBOARD_NAME
	default "Chastity"

config ZMK_SPLIT_ROLE_CENTRAL
	default y

endif

if SHIELD_CHASTITY_RIGHT

config ZMK_KEYBOARD_NAME
	default "Chastity Right"

endif

if SHIELD_CHASTITY_LEFT || SHIELD_CHASTITY_RIGHT

config ZMK_SPLIT
	default y

endif
```

## code/zmk/boards/shields/chastity/Kconfig.shield
```kconfig
config SHIELD_CHASTITY_LEFT
	def_bool $(shields_list_contains,chastity_left)

config SHIELD_CHASTITY_RIGHT
	def_bool $(shields_list_contains,chastity_right)
```
